## main/Kconfig.projbuild
```kconfig
menu "UDP LCD Controller Configuration"

    config UDP_LCD_PORT
        int "UDP listening port"
        default 5000
        range 1024 65535
        help
            UDP port number the device listens on for LCD control packets.

    config LCD_I2C_SDA_PIN
        int "I2C SDA GPIO pin"
        default 4
        range 0 21
        help
            GPIO pin number for I2C SDA line.

    config LCD_I2C_SCL_PIN
        int "I2C SCL GPIO pin"
        default 5
        range 0 21
        help
            GPIO pin number for I2C SCL line.

    config LCD_I2C_ADDR
        hex "PCF8574A I2C address"
        default 0x3F
        range 0x38 0x3F
        help
            7-bit I2C address of the PCF8574A I/O expander.
            Standard backpack address range: 0x38-0x3F.

    config LCD_DEFAULT_COLS
        int "Default LCD columns"
        default 20
        help
            Default column count before CMD_LCD_INIT overrides.

    config LCD_DEFAULT_ROWS
        int "Default LCD rows"
        default 4
        range 1 4
        help
            Default row count before CMD_LCD_INIT overrides.

    config LCD_I2C_FREQ_HZ
        int "I2C clock frequency (Hz)"
        default 100000
        help
            I2C master clock speed in Hz. 100000 for standard mode.

    config HEARTBEAT_LED_GPIO
        int "Heartbeat LED GPIO pin"
        default 8
        range -1 21
        help
            GPIO pin for the heartbeat indicator LED.
            The LED toggles on each heartbeat cycle (every 3s).
            Set to -1 to disable the LED.

    config WIFI_LED_GPIO
        int "Wi-Fi status LED GPIO pin"
        default 10
        range -1 21
        help
            GPIO pin for the Wi-Fi status indicator LED.
            SmartConfig provisioning: fast blink.
            Connected: steady on. Disconnected: off.
            Set to -1 to disable the LED.

    config WIFI_STA_MAX_RETRIES
        int "Wi-Fi STA max connection retries"
        default 3
        range 1 20
        help
            Number of STA connection attempts before falling back
            to SmartConfig provisioning.

    config WIFI_STA_RETRY_INTERVAL_MS
        int "Wi-Fi STA retry interval (ms)"
        default 2000
        range 500 30000
        help
            Delay in milliseconds between consecutive STA
            connection retry attempts.

endmenu
```

## sdkconfig.defaults
```kconfig
# Application defaults
CONFIG_UDP_LCD_PORT=2400
CONFIG_LCD_I2C_SDA_PIN=4
CONFIG_LCD_I2C_SCL_PIN=5
CONFIG_LCD_I2C_ADDR=0x3F
CONFIG_LCD_DEFAULT_COLS=20
CONFIG_LCD_DEFAULT_ROWS=4
CONFIG_LCD_I2C_FREQ_HZ=100000
CONFIG_HEARTBEAT_LED_GPIO=12
CONFIG_WIFI_LED_GPIO=13
CONFIG_WIFI_STA_MAX_RETRIES=3
CONFIG_WIFI_STA_RETRY_INTERVAL_MS=500

# FreeRTOS
CONFIG_FREERTOS_HZ=1000

# Partition table
CONFIG_PARTITION_TABLE_SINGLE_APP=y

# Log level
CONFIG_LOG_DEFAULT_LEVEL_INFO=y
```
